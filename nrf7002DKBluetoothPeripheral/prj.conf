## CMakeLists.txt
```
#
# Copyright (c) 2018 Nordic Semiconductor
#
# SPDX-License-Identifier: LicenseRef-Nordic-5-Clause
#
cmake_minimum_required(VERSION 3.20.0)

find_package(Zephyr REQUIRED HINTS $ENV{ZEPHYR_BASE})
project(peripheral_lbs)

# NORDIC SDK APP START
target_sources(app PRIVATE
  src/main.c
  src/bt_services.c
)

# NORDIC SDK APP END
```

## Kconfig
```
#
# Copyright (c) 2018 Nordic Semiconductor
#
# SPDX-License-Identifier: LicenseRef-Nordic-5-Clause
#

source "Kconfig.zephyr"

menu "My BLE GATT service sample"

# My Service configuration
config BT_MY_SERVICE
	bool "Enable My Service"
	select BT
	help
	  Enable My Service

config BT_MY_SERVICE_POLL_BUTTON
	bool "Enable polling of the button state"
	depends on BT_MY_SERVICE
	help
	  Enable periodic polling of the button state.

config BT_MY_SERVICE_SECURITY_ENABLED
	bool "Enable security for My Service"
	depends on BT_MY_SERVICE
	select BT_SMP
	select BT_SETTINGS
	select FLASH
	select FLASH_PAGE_LAYOUT
	select FLASH_MAP
	select ZMS if (SOC_FLASH_NRF_RRAM || SOC_FLASH_NRF_MRAM)
	select NVS if !(SOC_FLASH_NRF_RRAM || SOC_FLASH_NRF_MRAM)
	select SETTINGS
	help
	  Enable security for My Service.

endmenu
```

## prj.conf
```kconfig
#
# Copyright (c) 2018 Nordic Semiconductor
#
# SPDX-License-Identifier: LicenseRef-Nordic-5-Clause
#
CONFIG_NCS_SAMPLES_DEFAULTS=y

# Enable Bluetooth
CONFIG_BT=y
CONFIG_BT_PERIPHERAL=y

# Enable the My Service
CONFIG_BT_MY_SERVICE=y
CONFIG_BT_MY_SERVICE_POLL_BUTTON=y

# Enable settings subsystem
CONFIG_SETTINGS=y
CONFIG_BT_SETTINGS=y

# Enable security
CONFIG_BT_MY_SERVICE_SECURITY_ENABLED=y

# Enable DK library
CONFIG_DK_LIBRARY=y

# System configuration
CONFIG_SYSTEM_WORKQUEUE_STACK_SIZE=2048

# Logging configuration
CONFIG_LOG=y
# CONFIG_LOG_DEFAULT_LEVEL=4

CONFIG_SERIAL=y
CONFIG_UART_ASYNC_API=y
```

## src/main.c
```c
#include <zephyr/types.h>
#include <stddef.h>
#include <string.h>
#include <errno.h>
#include <zephyr/sys/printk.h>
#include <zephyr/sys/byteorder.h>
#include <zephyr/kernel.h>
#include <zephyr/drivers/gpio.h>
#include <soc.h>

#include <zephyr/bluetooth/bluetooth.h>
#include <zephyr/bluetooth/hci.h>
#include <zephyr/bluetooth/conn.h>
#include <zephyr/bluetooth/uuid.h>
#include <zephyr/bluetooth/gatt.h>

#include <zephyr/settings/settings.h>

#include <dk_buttons_and_leds.h>

#include "bt_services.h"
#include <zephyr/device.h>
#include <zephyr/drivers/uart.h>

#define DEVICE_NAME "RobotArm"
#define DEVICE_NAME_LEN (sizeof(DEVICE_NAME) - 1)

#define RUN_STATUS_LED DK_LED1
#define CON_STATUS_LED DK_LED1 // Connection status LED
#define RUN_LED_BLINK_INTERVAL 1000

#define INCREMENT_BUTTON DK_BTN1_MSK
#define DECREMENT_BUTTON DK_BTN2_MSK
#define GRIPPER_LED DK_LED2 // Gripper state indicator LED

#define RECEIVE_BUFF_SIZE 10
#define RECEIVE_TIMEOUT 100

static uint8_t rx_buf[RECEIVE_BUFF_SIZE] = {0};

static uint8_t gripperOpen = 0; // State variable for gripper (0=closed, 1=opened)

static const struct bt_data ad[] = {
	BT_DATA_BYTES(BT_DATA_FLAGS, (BT_LE_AD_GENERAL | BT_LE_AD_NO_BREDR)),
	BT_DATA(BT_DATA_NAME_COMPLETE, DEVICE_NAME, DEVICE_NAME_LEN),
};

static const struct bt_data sd[] = {
	BT_DATA_BYTES(BT_DATA_UUID128_ALL, BT_UUID_ANGLE_SERVICE_VAL),
};

const struct device *uart = DEVICE_DT_GET(DT_NODELABEL(uart0));

static void connected(struct bt_conn *conn, uint8_t err)
{
	if (err)
	{
		printk("Connection failed, err 0x%02x %s\n", err, bt_hci_err_to_str(err));
		return;
	}

	printk("Connected\n");

	dk_set_led_on(CON_STATUS_LED);
}

static void disconnected(struct bt_conn *conn, uint8_t reason)
{
	printk("Disconnected, reason 0x%02x %s\n", reason, bt_hci_err_to_str(reason));

	dk_set_led_off(CON_STATUS_LED);
}

#ifdef CONFIG_BT_MY_SERVICE_SECURITY_ENABLED
static void security_changed(struct bt_conn *conn, bt_security_t level,
							 enum bt_security_err err)
{
	char addr[BT_ADDR_LE_STR_LEN];

	bt_addr_le_to_str(bt_conn_get_dst(conn), addr, sizeof(addr));

	if (!err)
	{
		printk("Security changed: %s level %u\n", addr, level);
	}
	else
	{
		printk("Security failed: %s level %u err %d %s\n", addr, level, err,
			   bt_security_err_to_str(err));
	}
}
#endif

BT_CONN_CB_DEFINE(conn_callbacks) = {
	.connected = connected,
	.disconnected = disconnected,
};

static struct bt_conn_auth_cb conn_auth_callbacks;
static struct bt_conn_auth_info_cb conn_auth_info_callbacks;

static void update_gripper_open_led(void)
{
	// LED state is controlled by the gripper state
	dk_set_led(GRIPPER_LED, gripperOpen);
}

static void app_angle_cb(uint16_t angle1, uint16_t angle2, uint16_t angle3,
						 uint16_t angle4, uint16_t angle5, uint8_t state)
{
	printk("Angles updated: %d, %d, %d, %d, %d, State: %d\n",
		   angle1, angle2, angle3, angle4, angle5, state);
	gripperOpen = state; // Update gripper state based on received state value
	update_gripper_open_led();
}

static struct bt_my_service_cb my_service_callbacks = {
	.angle_cb = app_angle_cb,
};

// Shared function to send angles to Bluetooth
static void send_angles_bt(uint16_t angle1, uint16_t angle2, uint16_t angle3, uint16_t angle4, uint16_t angle5, uint8_t state)
{
	int err = bt_my_service_send_angles(angle1, angle2, angle3, angle4, angle5, state);
	if (err)
	{
		printk("Failed to send bt angles (err: %d)\n", err);
	}
}

// Shared function to send angles to UART
static void send_angles_uart(uint16_t angle1, uint16_t angle2, uint16_t angle3, uint16_t angle4, uint16_t angle5, uint8_t state)
{
	char tx_buf[32];
	int len = snprintf(tx_buf, sizeof(tx_buf), "%u,%u,%u,%u,%u,%u\n", angle1, angle2, angle3, angle4, angle5, state);
	if (len > 0 && len < sizeof(tx_buf))
	{
		int ret = uart_tx(uart, tx_buf, len, SYS_FOREVER_US);
		if (ret)
		{
			printk("Failed to send uart data (err: %d)\n", ret);
		}
	}
}

static void button_changed(uint32_t button_state, uint32_t has_changed)
{
	uint32_t buttons = button_state & has_changed;
	uint16_t angle1 = 0, angle2 = 0, angle3 = 0, angle4 = 0, angle5 = 0;
	uint8_t state = 0;

	if (buttons & (INCREMENT_BUTTON | DECREMENT_BUTTON))
	{
		bt_my_service_get_angles(&angle1, &angle2, &angle3, &angle4, &angle5, &state);

		// Determine if we're incrementing or decrementing
		int delta = (buttons & INCREMENT_BUTTON) ? 1 : -1;

		// Update angles with wrapping between 0 and 360
		angle1 = (angle1 + delta + 360) % 360;
		angle2 = (angle2 + delta + 360) % 360;
		angle3 = (angle3 + delta + 360) % 360;
		angle4 = (angle4 + delta + 360) % 360;
		angle5 = (angle5 + delta + 360) % 360;

		printk("Button pressed - New values:\n");
		printk("Angle1: %d, Angle2: %d, Angle3: %d, Angle4: %d, Angle5: %d, State: %d\n",
			   angle1, angle2, angle3, angle4, angle5, state);

		send_angles_bt(angle1, angle2, angle3, angle4, angle5, state);
		send_angles_uart(angle1, angle2, angle3, angle4, angle5, state);
	}
}

static void uart_cb(const struct device *dev, struct uart_event *evt, void *user_data)
{
	switch (evt->type)
	{
	case UART_RX_RDY:
		if (evt->data.rx.len > 0)
		{
			// get string from buffer
			char *str = (char *)evt->data.rx.buf;
			// format is "0,0,0,0,0,0\n"
			uint16_t angle1 = 0, angle2 = 0, angle3 = 0, angle4 = 0, angle5 = 0;
			uint8_t state = 0;
			int parsed = sscanf(str, "%hu,%hu,%hu,%hu,%hu,%hhu", &angle1, &angle2, &angle3, &angle4, &angle5, &state);
			if (parsed == 6)
			{
				printk("UART RX parsed: %d,%d,%d,%d,%d,%d\n", angle1, angle2, angle3, angle4, angle5, state);
				send_angles_bt(angle1, angle2, angle3, angle4, angle5, state);
			}
			else
			{
				printk("UART RX parse failed: %s\n", str);
			}
		}
		break;
	case UART_RX_DISABLED:
		uart_rx_enable(dev, rx_buf, sizeof rx_buf, RECEIVE_TIMEOUT);
		break;
	default:
		break;
	}
}

int main(void)
{
	int err;

	printk("Starting RobotArm program\n");

	err = dk_leds_init();
	if (err)
	{
		printk("LEDs init failed (err %d)\n", err);
		return 1;
	}

	err = dk_buttons_init(button_changed);
	if (err)
	{
		printk("Button init failed (err %d)\n", err);
		return 1;
	}

	if (!device_is_ready(uart))
	{
		printk("UART device not ready\n");
		return 1;
	}

	err = uart_callback_set(uart, uart_cb, NULL);
	if (err)
	{
		printk("Failed to set UART callback (err %d)\n", err);
		return 1;
	}

	err = uart_rx_enable(uart, rx_buf, sizeof rx_buf, RECEIVE_TIMEOUT);
	if (err)
	{
		printk("Failed to enable UART RX (err %d)\n", err);
		return 1;
	}

	// Initialize gripper LED state
	update_gripper_open_led();

	err = bt_enable(NULL);
	if (err)
	{
		printk("Bluetooth init failed (err %d)\n", err);
		return 0;
	}

	printk("Bluetooth initialized\n");

	if (IS_ENABLED(CONFIG_SETTINGS))
	{
		settings_load();
	}

	err = bt_my_service_init(&my_service_callbacks);
	if (err)
	{
		printk("Failed to init my service (err: %d)\n", err);
		return 1;
	}

	err = bt_le_adv_start(BT_LE_ADV_CONN, ad, ARRAY_SIZE(ad), sd,
						  ARRAY_SIZE(sd));
	if (err)
	{
		printk("Advertising failed to start (err %d)\n", err);
		return 1;
	}

	printk("Advertising successfully started\n");

	for (;;)
	{
		k_sleep(K_MSEC(RUN_LED_BLINK_INTERVAL));
	}
}
```

## src/bt_services.c
```c
#include <zephyr/types.h>
#include <stddef.h>
#include <string.h>
#include <errno.h>
#include <zephyr/sys/printk.h>
#include <zephyr/sys/byteorder.h>
#include <zephyr/kernel.h>

#include <zephyr/bluetooth/bluetooth.h>
#include <zephyr/bluetooth/hci.h>
#include <zephyr/bluetooth/conn.h>
#include <zephyr/bluetooth/uuid.h>
#include <zephyr/bluetooth/gatt.h>

#include <zephyr/logging/log.h>
#include "bt_services.h"

static bool angle_notify_enabled;
static uint16_t angle_values[5] = {0, 0, 0, 0, 0};
static uint8_t angle_state = 0;
static struct bt_my_service_cb my_service_cb;

static void angle_ccc_cfg_changed(const struct bt_gatt_attr *attr,
                                uint16_t value)
{
    angle_notify_enabled = (value == BT_GATT_CCC_NOTIFY);
}

static ssize_t read_angle(struct bt_conn *conn,
                         const struct bt_gatt_attr *attr,
                         void *buf,
                         uint16_t len,
                         uint16_t offset)
{
    uint8_t data[13]; // 5 angles (2 bytes each) + 1 state byte
    sys_put_le16(angle_values[0], &data[0]);
    sys_put_le16(angle_values[1], &data[2]);
    sys_put_le16(angle_values[2], &data[4]);
    sys_put_le16(angle_values[3], &data[6]);
    sys_put_le16(angle_values[4], &data[8]);
    data[10] = angle_state;

    return bt_gatt_attr_read(conn, attr, buf, len, offset, data, sizeof(data));
}

static ssize_t write_angle(struct bt_conn *conn,
                         const struct bt_gatt_attr *attr,
                         const void *buf,
                         uint16_t len, uint16_t offset, uint8_t flags)
{
    if (len != 13) { // 5 angles (2 bytes each) + 1 state byte
        return BT_GATT_ERR(BT_ATT_ERR_INVALID_ATTRIBUTE_LEN);
    }

    if (offset != 0) {
        return BT_GATT_ERR(BT_ATT_ERR_INVALID_OFFSET);
    }

    if (my_service_cb.angle_cb) {
        const uint8_t *data = buf;
        uint16_t new_angles[5];
        uint8_t new_state;

        new_angles[0] = sys_get_le16(&data[0]);
        new_angles[1] = sys_get_le16(&data[2]);
        new_angles[2] = sys_get_le16(&data[4]);
        new_angles[3] = sys_get_le16(&data[6]);
        new_angles[4] = sys_get_le16(&data[8]);
        new_state = data[10];

        // Validate angles are within 0-360 range
        for (int i = 0; i < 5; i++) {
            if (new_angles[i] > 360) {
                return BT_GATT_ERR(BT_ATT_ERR_VALUE_NOT_ALLOWED);
            }
        }

        // Validate state is 0 or 1
        if (new_state > 1) {
            return BT_GATT_ERR(BT_ATT_ERR_VALUE_NOT_ALLOWED);
        }

        memcpy(angle_values, new_angles, sizeof(angle_values));
        angle_state = new_state;
        my_service_cb.angle_cb(new_angles[0], new_angles[1], new_angles[2],
                              new_angles[3], new_angles[4], new_state);
    }

    return len;
}

/* Service Declaration */
BT_GATT_SERVICE_DEFINE(angle_service,
    BT_GATT_PRIMARY_SERVICE(BT_UUID_ANGLE_SERVICE),
    BT_GATT_CHARACTERISTIC(BT_UUID_ANGLE,
                          BT_GATT_CHRC_READ | BT_GATT_CHRC_WRITE | BT_GATT_CHRC_NOTIFY,
                          BT_GATT_PERM_READ | BT_GATT_PERM_WRITE,
                          read_angle, write_angle, NULL),
    BT_GATT_CCC(angle_ccc_cfg_changed,
                BT_GATT_PERM_READ | BT_GATT_PERM_WRITE),
);

int bt_my_service_init(struct bt_my_service_cb *callbacks)
{
    if (callbacks) {
        my_service_cb.angle_cb = callbacks->angle_cb;
    }

    return 0;
}

int bt_my_service_send_angles(uint16_t angle1, uint16_t angle2, uint16_t angle3,
                             uint16_t angle4, uint16_t angle5, uint8_t state)
{
    if (!angle_notify_enabled) {
        return -EACCES;
    }

    // Validate angles are within 0-360 range
    if (angle1 > 360 || angle2 > 360 || angle3 > 360 ||
        angle4 > 360 || angle5 > 360) {
        return -EINVAL;
    }

    // Validate state is 0 or 1
    if (state > 1) {
        return -EINVAL;
    }

    angle_values[0] = angle1;
    angle_values[1] = angle2;
    angle_values[2] = angle3;
    angle_values[3] = angle4;
    angle_values[4] = angle5;
    angle_state = state;

    uint8_t data[13];
    sys_put_le16(angle1, &data[0]);
    sys_put_le16(angle2, &data[2]);
    sys_put_le16(angle3, &data[4]);
    sys_put_le16(angle4, &data[6]);
    sys_put_le16(angle5, &data[8]);
    data[10] = state;

    return bt_gatt_notify(NULL, &angle_service.attrs[1],
                         data, sizeof(data));
}

void bt_my_service_get_angles(uint16_t *angle1, uint16_t *angle2, uint16_t *angle3,
                             uint16_t *angle4, uint16_t *angle5, uint8_t *state)
{
    if (angle1) *angle1 = angle_values[0];
    if (angle2) *angle2 = angle_values[1];
    if (angle3) *angle3 = angle_values[2];
    if (angle4) *angle4 = angle_values[3];
    if (angle5) *angle5 = angle_values[4];
    if (state) *state = angle_state;
}
```

## src/bt_services.h
```c
#ifndef BT_SERVICES_H_
#define BT_SERVICES_H_

#ifdef __cplusplus
extern "C" {
#endif

#include <zephyr/types.h>

/** @brief Angle Service UUID. */
#define BT_UUID_ANGLE_SERVICE_VAL \
	BT_UUID_128_ENCODE(0x0000A000, 0x1212, 0xefde, 0x1523, 0x785feabcd123)

/** @brief Angle Characteristic UUID. */
#define BT_UUID_ANGLE_VAL \
	BT_UUID_128_ENCODE(0x0000A001, 0x1212, 0xefde, 0x1523, 0x785feabcd123)

/** @brief Service Name Characteristic UUID. */
#define BT_UUID_SERVICE_NAME_VAL \
	BT_UUID_128_ENCODE(0x0000A002, 0x1212, 0xefde, 0x1523, 0x785feabcd123)

#define BT_UUID_ANGLE_SERVICE BT_UUID_DECLARE_128(BT_UUID_ANGLE_SERVICE_VAL)
#define BT_UUID_ANGLE BT_UUID_DECLARE_128(BT_UUID_ANGLE_VAL)
#define BT_UUID_SERVICE_NAME BT_UUID_DECLARE_128(BT_UUID_SERVICE_NAME_VAL)

/** @brief Callback type for angle value change. */
typedef void (*angle_cb_t)(uint16_t angle1, uint16_t angle2, uint16_t angle3,
                          uint16_t angle4, uint16_t angle5, uint8_t state);

/** @brief Callback struct used by Angle Service. */
struct bt_my_service_cb {
	/** Angle value change callback. */
	angle_cb_t angle_cb;
};

/** @brief Initialize Angle Service.
 *
 * This function registers a GATT service with one characteristic:
 * - Angle: Read, Write and Notify
 *
 * @param[in] callbacks Struct containing pointers to callback functions
 *			used by the service. This pointer can be NULL
 *			if no callback functions are defined.
 *
 * @retval 0 If the operation was successful.
 *           Otherwise, a (negative) error code is returned.
 */
int bt_my_service_init(struct bt_my_service_cb *callbacks);

/** @brief Send angle values.
 *
 * This function sends the angle values to all connected peers.
 *
 * @param[in] angle1 First angle value (0-360)
 * @param[in] angle2 Second angle value (0-360)
 * @param[in] angle3 Third angle value (0-360)
 * @param[in] angle4 Fourth angle value (0-360)
 * @param[in] angle5 Fifth angle value (0-360)
 * @param[in] state Binary state (0 or 1)
 *
 * @retval 0 If the operation was successful.
 *           Otherwise, a (negative) error code is returned.
 */
int bt_my_service_send_angles(uint16_t angle1, uint16_t angle2, uint16_t angle3,
                             uint16_t angle4, uint16_t angle5, uint8_t state);

/** @brief Get current angle values.
 *
 * @param[out] angle1 First angle value
 * @param[out] angle2 Second angle value
 * @param[out] angle3 Third angle value
 * @param[out] angle4 Fourth angle value
 * @param[out] angle5 Fifth angle value
 * @param[out] state Binary state
 */
void bt_my_service_get_angles(uint16_t *angle1, uint16_t *angle2, uint16_t *angle3,
                             uint16_t *angle4, uint16_t *angle5, uint8_t *state);

#ifdef __cplusplus
}
#endif

#endif /* BT_SERVICES_H_ */
```
